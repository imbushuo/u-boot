## lib/efi_loader/Kconfig
```kconfig
config EFI_LOADER
	bool "Support running EFI Applications in U-Boot"
	depends on (ARM || X86) && OF_LIBFDT && !TARGET_OPENRD
	default y
	help
	  Select this option if you want to run EFI applications (like grub2)
	  on top of U-Boot. If this option is enabled, U-Boot will expose EFI
	  interfaces to a loaded EFI application, enabling it to reuse U-Boot's
	  device drivers.

config EFI_LOADER_BOUNCE_BUFFER
	bool "EFI Applications use bounce buffers for DMA operations"
	depends on EFI_LOADER && ARM64
	default n
	help
	  Some hardware does not support DMA to full 64bit addresses. For this
	  hardware we can create a bounce buffer so that payloads don't have to
	  worry about platform details.

config EFI_TRACING
	bool "Enable EFI serial output tracing in U-Boot"
	depends on (ARM || X86) && EFI_LOADER
	default n
	help
		Enable EFI serial output tracing for debugging certain conditions.

config ARM_ACPI
	bool "Enable Hardware-reduced ACPI support for ARM systems in U-Boot"
	depends on ARM && EFI_LOADER
	default n
	help
		Enable hardware-reduced ACPI support for ARM/ARM64-based EFI systems.
		Currently all ACPI tables are emitted and embedded into binary as part
		of the build process. ACPI is a prerequisite for certain operating 
		system like Microsoft Windows.
```
