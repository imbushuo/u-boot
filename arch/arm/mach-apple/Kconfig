## arch/arm/mach-apple/Kconfig
```kconfig
if ARCH_APPLE

config TEXT_BASE
	default 0x00000000

config SYS_SOC
	default "apple"

config SYS_VENDOR
	default "apple"

config SYS_BOARD
	string "Board name"
	default "mac"
	help
	  This option contains information about board name.
	  Based on this option board/<CONFIG_SYS_VENDOR>/<CONFIG_SYS_BOARD> will
	  be used.
	  Apple silicon based devices are expected to use the generic board name
	  "mac".

config SYS_MALLOC_LEN
	default 0x4000000

config SYS_MALLOC_F_LEN
	default 0x4000

config LNX_KRNL_IMG_TEXT_OFFSET_BASE
	default TEXT_BASE

config EFI_APPLE_SYNTHETIC_TIME
	bool "Synthetic EFI clock based on the architectural timer"
	depends on EFI_LOADER
	select EFI_HAVE_RUNTIME_GET_TIME
	select LIB_DATE
	help
	  Provide read-only EFI GetTime before and after ExitBootServices.
	  Time starts at 2026-10-21 00:00:00 UTC during U-Boot startup and
	  advances using the ARM architectural counter. This is not a real
	  RTC: the epoch resets on every boot and SetTime is unsupported.
	  Intended for bring-up until a runtime-safe Apple RTC is available.

endif
```
